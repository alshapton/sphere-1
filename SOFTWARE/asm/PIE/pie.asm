;
;      DIRECTIVES FOR ASSEMBLY FOR SBASM3
;
        .CR 6800               ; LOAD MC6800 CROSS OVERLAY
        .TF TARGET.HEX,HEX     ; OUTPUT FILE TO TARGET.BIN IN BINARY FORMAT
        .OR $00                ; START OF ASSEMBLY ADDRESS

;      SBASM3 ALSO NEEDED EQU CHANGING TO .EQU
;                         COMMENTS CHANGING FROM * TO ;
;                         LABELS AND CONSTANTS WITH A PLUS SIGN NEED RENAMING:
;                              TMP+1  -> TMPAND1
;                              TMP1+1 -> TMP1AND1
;                              NUM+1  -> NUMAND1
;                              CPSV+1 -> CPSVAND1
;                              CSRP+1 -> CSRPAND1
;                         CHANGED DS DIRECTIVE TO .TW   
;                       
;
; PIE TEXT EDITOR V1.1 
; TOM CROSLEY
;
; FOR SPHERE WITH PDS 
; V3N FIRMWARE
;
; RECOVERED FROM TAPE 
; 11/2022 BEN ZOTTO
;
; 
; REFORMATTED TO WORK WITH SBASM3
; 06/2023 ANDREW SHAPTON
;
; MODIFIED ORIGINAL BEGINS BELOW
;

TMP         .EQU    0
TMPAND1     .EQU    1
TMP1        .EQU    2
TMP1AND1    .EQU    3
NUM         .EQU    4
NUMAND1     .EQU    5
ARA         .EQU    6
NFOUND      .EQU    6
AR0         .EQU    7
BUFADR      .EQU    $C
BUFEND      .EQU    $E
INSFLG      .EQU    $10
TAB         .EQU    $13
DSTADR      .EQU    $16
CPSAVE      .EQU    $18
CPSVAND1    .EQU    $19
CSRPTR      .EQU    $1C
CSRPAND1    .EQU    $1D
BUFFLO      .EQU    $20
BUFFHI      .EQU    $22
SCNPTR      .EQU    $24
EDITF       .EQU    $32
;
; EDITOR IS SELF-RELOCATING AND
; MUST BE ASSEMBLED AT 0
; ORG 0 
; MOVED TO FRONT OF PROGRAM AS REQUIRED BY SBASM3
; DO NOT MOVE NEXT 3 INSTRS!
EDIT    BRA     EDIT1  		; NEW BUFFER
REDIT   BRA     REDIT1 		; OLD BUFFER
GENORG  BSR     TBLRET 		; GEN TABLE ORG
;
; DS 2 'INVALD' 0
; DS 2'TABLFT' CTRL-A
; DS 2'BOTTOM'      B
; DS 2'ADD32X'      C
; DS 2'UPHOME'      D
; DS 2'SUB32X'      E
; DS 2'RTARRO'      F
; DS 2'TABRGT'      G
; DS 2'DESBKS'      H
; DS 2'INSERT'      I
; DS 2'GOBBLE'      J
; DS 2'DELETE'      K
; DS 2'CLEARL'      L
; DS 2'CRLFXX'      M
; DS 2'CLOSET'      N
; DS 2'INSOFF'      O
; DS 2'CHRINS'      P
; DS 2'SCHBCK'      Q
; DS 2'UPPAGE'      R
; DS 2'LFARRO'      S
; DS 2'GOTONN'      T
; DS 2'APPEND'      U
; DS 2'DNPAGE'      V
; DS 2'TABUPX'      W
; DS 2'TABDWN'      X
; DS 2'BOTOUT'      Y
; DS 2'SCHFWD'      Z
; DS 2'ESCAPE' <ESCAPE>
; DS 2'INVALD' CTRL-\
; DS 2'SETTAB'      ]
; DS 2'HOMLIN'      ^
; DS 2'LFTJST'      _
;
       .TW 'INVALD' ; 0
       .TW 'TABLFT' ; CTRL-A
       .TW 'BOTTOM' ; B
       .TW 'ADD32X' ; C
       .TW 'UPHOME' ; D
       .TW 'SUB32X' ; E
       .TW 'RTARRO' ; F
       .TW 'TABRGT' ; G
       .TW 'DESBKS' ; H
       .TW 'INSERT' ; I
       .TW 'GOBBLE' ; J
       .TW 'DELETE' ; K
       .TW 'CLEARL' ; L
       .TW 'CRLFXX' ; M
       .TW 'CLOSET' ; N
       .TW 'INSOFF' ; O
       .TW 'CHRINS' ; P
       .TW 'SCHBCK' ; Q
       .TW 'UPPAGE' ; R
       .TW 'LFARRO' ; S
       .TW 'GOTONN' ; T
       .TW 'APPEND' ; U
       .TW 'DNPAGE' ; V
       .TW 'TABUPX' ; W
       .TW 'TABDWN' ; X
       .TW 'BOTOUT' ; Y
       .TW 'SCHFWD' ; Z
       .TW 'ESCAPE' ; <ESCAPE>
       .TW 'INVALD' ; CTRL-\
       .TW 'SETTAB' ; ]
       .TW 'HOMLIN' ; ^
       .TW 'LFTJST' ; _
;

EDIT1 	LDX 	BUFADR 		; STRT OF LO BUF
 	STX 	BUFFLO 		; END+1 OF LOW BUF
 	LDX	BUFEND 		; STRT-1 OF HIGH BUF
 	STX 	BUFFHI		; END OF HIGH BUF
;
REDIT1 	JSR 	UPHOME
 	JSR 	CLEAR		; SCREEN
 	CLRA
 	STAA 	INSFLG 		; INS MODE OFF
 	STAA 	SRCHBF 		; NULL STRING
 	INCA
 	STAA 	EDITF
 	LDAA 	=8 		; DEFAULT TABS = 8
 	STAA 	TAB
 	LDX 	CSRPTR
 	STX 	SCNPTR
;
RDLP 	BSR 	ENDCR 		; PUT CR IN COL 32
 	LDX 	KBDPIA
 	LDAA 	0,X 		; CLEAR OUT INPUT BUF
 	JSR 	GETCHR
 	CMPA 	=$20
 	BGE 	REGCHR
; CONTROL CHAR (EDITOR COMMAND)
 	LDX 	=1 		; DEFAULT ARGUMENT
 	STX 	NUM
 	ASLA
RL10 	BRA 	GENORG 		; GET TABLE ORG
TBLRET 	TSX 
 	LDX 	0,X
 	DEX
 	DEX
	DEX
 	DEX
 	DEX
 	DEX
 	STX 	TMP1 		; SAVE ABS PROG ORG
 	INS
 	INS
 	CLRB
 	PSHA
 	ADDA 	TMP1AND1 	; ADD CHAR*2 TO ORG
 	ADCB 	TMP1 		; TO FORM TABLE INDEX
 	JSR 	LOADX
 	LDAB 	6,X 		; GET REL TBL ENTRY
 	LDAA 	7,X
 	JSR 	LOADX 		; SAVE IN X
;
 	CMPB 	=$FB 		; SYSTEM CALL?
 	BCC 	RL15
 	ADDA 	TMP1AND1 	; ADD ORIGIN TO FORM
 	ADCB 	TMP1 		; ABSOLUTE JSR ADDR
RL15 	STAB 	TMP1
 	STAA 	TMP1AND1
 	PULA
;
 	LDAB 	EDITF
 	CMPB 	=2
 	BNE 	RL20
; ESCAPE MODE - INPUTTING ARG
 	CPX 	=DESBKS 	; CMP REL ADDR
 	BEQ 	1+*
; RET TO ESCAPE WITH ARG IN A
; AND REL TABLE ENTRY IN X
 	RTS
 	BSR 	ESCBKS 		; BACKSPACE IN ARG
 	BRA 	RDLP
;
RL20 	LDAB 	=$7E 		; SET UP JUMP
 	STAB 	TMPAND1
 	LDX 	CSRPTR
 	STX 	CPSAVE 		; SAVE ORIG CURSOR
 	JSR 	TMPAND1 
	JSR 	SUB		; CURSOR IN X
 	LDAB 	EDITF
 	CMPB 	=2
 	BNE 	RL30
 	DEC 	EDITF 		; RETURN FROM ESCAPE
 	BRA 	RL10 		; GO EXEC COMMAND IN A
RL30 TSTB
 BEQ 2+* EDIT OFF - EXIT
RDLP1 BRA RDLP
INVALD RTS
;
; PUT INT CR AT END OF LINE
ENDCR LDAA CSRPAND1
 ORAA =$1F
 LDAB CSRPTR
 JSR LOADX SAVE END PTR IN TMP
 LDAB =$60
 STAB 0,X
 RTS
;
; REGULAR (NON-CTRL) CHAR
REGCHR LDAB INSFLG
 PSHA
 BEQ RC10
; INSERT MODE - MOVE CHARS OVER
 BSR INSCHR
RC10 BSR ENDCR GET PTR TO EOL
 PULA
 LDX CSRPTR
 CPX TMP
 BEQ RDLP1 CHAR NOT ALLOWED
 PSHA
 BSR FIXBLK FIXUP PREV CR'S
 PULA
 LDX CSRPTR
 JSR EDTCHR PUT CHAR ON SCREEN
 BRA RDLP1
;
;
; BACKSPACE DURING ESCAPE MODE
ESCBKS BSR BEGPT0
 INC TMPAND1 CAN'T BS OVER '?'
 BRA DB10
;
; ESCAPE - GET NUMERIC OR
; STRING ARG (SEARCH ONLY)
ESCAPE LDAA INSFLG
 PSHA
 CLR INSFLG INSCHR OFF FOR ARG
 JSR INSTOP INSERT LINE FOR ARG
 LDAA ='?'
 JSR PUTCHR
 INC EDITF =2
 BSR RDLP1 RECURSIVE CALL
 PULB
 STAB INSFLG
 PSHA
 CPX =SCHBCK CHK IF STR ARG
 BEQ ES10
 CPX =SCHFWD
 BNE ES15
ES10 BSR GETSTR
 BRA ES20
ES15 JSR UPHOME NUMERIC ARG
 JSR ADCBIN CONV TO BIN
 STAB NUM AND SAVE
 STAA NUMAND1
ES20 JSR DELTOP REMOVE ARG LINE
 PULA
 LDX CPSAVE
 STX CSRPTR RESTORE CURSOR
ES30 RTS
;
ENDCR1 BRA ENDCR
;
; INSERT CHAR MOVE SUB
INSCHR BSR ENDCR GET END PTR
IC10 CPX CSRPTR
 BEQ ES30
 DEX
 LDAA 0,X MOVE CHARS OVER
 STAA 1,X
 BRA IC10
;
BEGPT0 BRA BEGPTR
;
; GET STRING ARG INTO BUFFER
GETSTR CPX =$E001 NO STR?
 BEQ GS10
 LDX =SRCHBF STR BUFFER
 STX DSTADR
 JSR UPHOME
 JSR MOVE1A MOVE STRING
 DEX
 CLR 0,X END OF STR PTR
GS10 RTS
;
; CHANGE CR'S LEFT OF CURSOR
; INTO SPACES SO CHAR ISN'T
; LOST WHEN SCREEN SCROLLED
FIXBLK BSR BEGPTR
 LDX CSRPTR
FB10 LDAA 0,X
 CMPA =$60
 BNE FB20
 LDAA =' '
 STAA 0,X
FB20 CPX TMP
 BEQ DB20
 DEX
 BRA FB10
;
; DESTRUCTIVE BACKSPACE
DESBKS BSR BEGPTR
DB10 LDX CSRPTR
 CPX TMP
 BEQ DB20
 DEX
 STX CSRPTR NEW CURSOR POSITION
 LDAA INSFLG
; IN INS MODE, ALL CHARS <-
 BNE GOBBLE
 LDAA =' '
 STAA 1,X
DB20 RTS
;
; MOVE CHARS TO RIGHT OF CURSOR
; LEFT ONE POS
GOBBLE BSR ENDCR1
 LDX CSRPTR
GB10 CPX TMP
 BEQ DB20
 LDAA 1,X
 STAA 0,X
 INX
 BRA GB10
;
; GET PTR TO BEG OF LINE
BEGPTR LDAA CSRPAND1
 ANDA =$E0
 LDAB CSRPTR
 JMP LOADX SAVE PTR IN TMP
;
; MOVE UP ONE PAGE (TOWARD TOP
; OF FILE)
UPPAGE BSR GETPAG
 BSR UPINBA
UPP10 ABA
 BNE 4+*
 LDX CPSAVE RES CURSOR
 STX CSRPTR
 RTS
;
;
GETPAG LDX NUM
 BNE GP10
 CLRB
 LDAA =8 <ESC> ONLY, HALF PAGE
 RTS
GP10 LDX =16
 STX ARA
 LDAB NUM
 LDAA NUMAND1
; # OF LINES = 16*NUM
 JMP MULT
;
; MOVE DOWN ONE PAGE (TOWARD
; BOTTOM OF FILE)
DNPAGE BSR GETPAG
 BSR DNINBA
 BRA UPP10
;
; GET LOWER ORDER BYTE OF ARG
GETNUM CLRB
 LDAA NUM
 BEQ 3+*
 LDAA =$FF IF >255; CHG TO 255
 RTS
 LDAA NUMAND1
 BNE 1+*
; CHANGE DEFAULT (0) TO 1
 INCA
 RTS
;
BEGPT1 BRA BEGPTR
;
; VERTICAL TAB DOWN
TABDWN LDAB CSRPTR
 CMPB =$E1 MID OF SCREEN?
 BLT TD10
 LDAB =$E1
 LDAA CSRPAND1
 ORAA =$E0 LAST LINE
 BRA TD30
TD10 LDAB =$E1 MIDDLE LINE
TD20 LDAA CSRPAND1
 ANDA =$1F KEEP HORIZ POS
TD30 STAB CSRPTR
 STAA CSRPAND1
 RTS
;
; VERTICAL TAB UP
TABUPX LDAB CSRPTR
 LDAA CSRPAND1
 ANDA =$E0 LEFT JUSTIFY
 SUBA =1
 SBCB =0
 CMPB =$E1 MID OF SCREEN?
 BGE TD10
 LDAB =$E0 FIRST LINE
 BRA TD20
;
;
; MOVE UP FOR NUMBER OF
; LINES SPECIFIED IN BA
UPINBA JSR UPHOME
UP10 LDX BUFFLO CHK IF AT TOP
 CPX BUFADR
 BEQ UP20
 PSHB
 JSR SUB32X
 PULB
 SUBA =1
 SBCB =0
 BNE UP10
 TSTA
 BNE UP10
UP20 RTS
;
; MOVE DOWN FOR NUMBER OF
; LINES SPECIFIED IN BA
DNINBA LDX =$E1E0
 STX CSRPTR
DN10 LDX BUFFHI CHK IF BOTTOM
 CPX BUFEND
 BEQ DN20
 PSHB
 LDX CSRPTR
 JSR ADD32X
 PULB
 SUBA =1
 SBCB =0
 BNE DN10
 TSTA
 BNE DN10
DN20 RTS
;
GETNM1 BRA GETNUM
;
; CLEAR LINE FROM CURSOR TO
; END OF LINE
CLEARL LDAA CSRPAND1
 ORAA =$1F
 LDAB CSRPTR
 JSR LOADX
 LDAB =$60
 JMP CLEAR2
;
; SET UP TO APPEND TO EOL
APPEND BSR FNDEND
 CMPA =$60
 BEQ 1+*
 INX
 STX CSRPTR
 RTS
;
; FIND LAST CHAR IN LINE
FNDEND BSR BEGPT1
 STX NUM
 ORAA =$1F
 JSR LOADX
 INX
FE10 DEX
 LDAA 0,X
 CMPA =$60
 BNE FE20
 CPX NUM
 BNE FE10
FE20 RTS
;
UPBA1 BRA UPINBA
;
; DELETE BLANKS LINES (IF ANY)
CLOSET BSR FNDEND
 CMPA =$60 EMPTY LINE
 BNE CL10
 BSR DELCUR
 LDX BUFFHI CHK END OF FILE
 CPX BUFEND
 BNE CLOSET
CL10 RTS
;
; DELETE N LINES
DELETE BSR GETNM1
DL10 BSR DELCUR
 DECA
 BNE DL10
 RTS
;
; DELETE CURRENT LINE
DELCUR JSR LFTJST
 LDX CSRPTR
 JSR SCRP2 SCROLL SCREEN UP
 JSR OVR3 MOVE CHARS TO LAST
 LDX CPSAVE
 STX CSRPTR RESTORE CURSOR
 JMP LFTJST TO LEFT OF LINE
;
DNBA1 BRA DNINBA
;
; INSERT N BLANK LINES BEFORE
; CURRENT LINE
INSERT BSR GETNM1
 JSR LFTJST
IN10 PSHA
 JSR MOVE2 MOVE LAST OFF SCREEN
 LDX =$E1E0
IN20 CPX CSRPTR
 BEQ IN30
 DEX
 LDAB 0,X MOVE LINES DOWN
 STAB 32,X
 BRA IN20
IN30 BSR CLEARL CLEAR CUR LINE 
 PULA
 DECA
 BNE IN10
 RTS
;
; MOVE CURRENT LINE TO TOP
HOMLIN JSR LFTJST
 LDAB CSRPTR
 LDAA CSRPAND1
 LSRB
 RORA
 LSRA
 LSRA
 LSRA
 LSRA
HL05 BEQ HL10
 BSR BTHOME
 JSR ADD32X
 DECA
 BRA HL05
HL10 JSR UPHOME
 LDAA CPSVAND1
 ANDA =$1F
 STAA CSRPAND1 RES ORIG HORIZ POS
 RTS
;
; HOME AT BOTTOM
BTHOME LDX =$E1E0
 STX CSRPTR
 RTS
;
; GOTO TOP OF FILE
TOP CLRB
 CLRA
UPBA2 BRA UPBA1
DNBA2 BRA DNBA1
;
; GOTO BOTTOM & EXIT
BOTOUT BSR BOTTOM
 CLR EDITF
 RTS
;
; GOTO BOTTOM OF FILE
BOTTOM CLRB
 CLRA
 BSR DNBA2 MOVE OUT OF HIGH BUF
; SCROLL UP TILL SCREEN CLEAR
BT10 JSR UPHOME 
 LDAA =$60
 LDX =$E200
BT20 DEX
 CMPA 0,X
 BNE BT30 NOT DONE YET
 CPX CSRPTR
 BNE BT20
 RTS
BT30 BSR BTHOME
 JSR ADD32X SCROLL UP
 BRA BT10
;
HOML1 BRA HOMLIN
BOTTM1 BRA BOTTOM
;
; GOTO LINE (ARG)
GOTONN LDX NUM
 BEQ TOP
 DEX
 BEQ TOP =1, LINE 1
 LDAA =1
 STAA NFOUND INIT NOT FOUND
 LDX =0
 STX TMP1 INIT LINE CTR
;
 LDX BUFADR
; LOOK FOR LINE IN LOW BUFFER
GT10 CPX BUFFLO
 BEQ GT20
 LDAA 0,X
 INX
 CMPA =$60
 BNE GT10
 BSR CHKNUM CHECK IF FOUND
 BRA GT10
;
GT20 LDAA NFOUND
 BNE GOTOSC
 LDAB TMP1 FOUND TARGET LINE
 LDAA TMP1AND1
 ADDA =1
 ADCB =0
 SUBA NUMAND1
 SBCB NUM
UPBA3 BRA UPBA2 MOVE UP IN FILE
DNBA3 BRA DNBA2 MOVE DOWN
;
; LOOK FOR LINE ON SCREEN
GOTOSC JSR UPHOME
GT30 LDX CSRPTR
GT40 CPX =$E200
 BEQ GT50
 LDAA 0,X
 INX
 CMPA =$60
 BNE GT40
 BSR CHKNUM CHK IF FOUND
 LDAA NFOUND
 BEQ GT50
 LDX CSRPTR
 CPX =$E1E0 IF NOT AT BOTTOM
 BEQ GT50 MOVE CURSOR DOWN
 JSR CRLFXX
 BRA GT30
;
GT50 LDAA NFOUND
 BNE GT60
 BRA HOML1 LINE ON SCREEN
; LINE MUST BE IN HIGH BUF
GT60 LDAB NUM
 LDAA NUMAND1
 SUBA TMP1AND1
 SBCB TMP1
 BSR DNBA3 GOTO TO IT
 ABA
 BEQ 2+* RUN INTO END?
 BRA BOTTM1
HOML2 BRA HOML1
;
CHKNUM STX TMP SAVE BUF ADDR
 LDX TMP1 GET LINE CTR
 INX
 STX TMP1 SAVE INCR CTR
 CPX NUM COMPARE WITH TARGET
 BNE 3+*
 CLR NFOUND FOUND IT
 LDX TMP
 RTS
;
; SEARCH BACKWARD FOR STRING
; IN LOW BUF
SCHBCK LDX =0 INIT LINE CTR
 STX TMP1
 LDX BUFFLO
SB10 CPX BUFADR
 BNE 1+*
 RTS
 DEX
 LDAA 0,X
 CMPA =$60
 BNE 4+*
 BSR CHKNUM INC LINE CTR
 BRA SB10
 CMPA SRCHBF CHAR MATCH?
 BNE SB10
 BSR CMPSTR STRING MATCH?
 BNE SB10
 LDAB TMP1 YES
 LDAA TMP1AND1
 BSR UPBA3
 BRA HOMSTR
;
DNBA4 BRA DNBA3
;
; SEARCH FORWARD FOR STRING,
; FIRST ON SCREEN
SCHFWD LDX =$E020 BEG 2ND LINE
SF10 CPX =$E200 END OF SCREEN
 BEQ SF25 GO CHECK HIGH BUF
 LDAA 0,X
 CMPA =$60
 BNE SF20
 STX TMP
 LDAA TMPAND1
 ORAA =$1F END OF LINE
 STAA TMPAND1
 LDX TMP
SF15 INX
 BRA SF10
SF20 CMPA SRCHBF CHAR MATCH?
 BNE SF15
 BSR CMPSTR STRING MATCH?
 BNE SF15
 STX CSRPTR YES
HOML3 BRA HOML2 LINE TO TOP
;
; SEARCH IN HIGH BUF
SF25 LDX =1
 STX TMP1
 LDX BUFFHI
SF30 CPX BUFEND
 BNE 1+*
 RTS
 INX
 LDAA 0,X
 CMPA =$60
 BNE 4+*
 BSR CHKNUM INC LINE CTR
 BRA SF30
 CMPA SRCHBF CHAR MATCH?
 BNE SF30
 BSR CMPSTR STRING MATCH?
 BNE SF30
 LDAB TMP1 YES
 LDAA TMP1AND1
 BSR DNBA4 MOVE TO LINE
 BSR HOML3
;
; MOVE CURSOR TO BEG OF STR
HOMSTR LDX =$DFFF
HS10 INX
 LDAA 0,X
 CMPA SRCHBF
 BNE HS10
 BSR CMPSTR
 BNE HS10
 STX CSRPTR SAVE BEG OF STRING
 RTS
;
; COMPARE STR (X) WITH STR BUF
CMPSTR STX CPSAVE TMP SAVE
 STX TMP EDIT BUF PTR
 LDX =SRCHBF
CS10 STX NUM STR BUF PTR
 LDX TMP
 INX
 STX TMP
 LDAA 0,X EDIT BUF CHAR
 LDX NUM
 INX
 LDAB 0,X STR BUF CHAR
 CBA
 BEQ CS10
 LDX CPSAVE RES ORIG PTR
; IF STRINGS =, ACCB = 0 (END)
 TSTB
 RTS
;
; HORIZ TAB RIGHT
TABRGT BSR GETTAB GET LAST TAB
 ADDA TAB NEXT TAB TO RIGHT
 CMPA =31
 BLE 2+*
 LDAA =31
TB10 LDAB CSRPAND1
 ANDB =$E0
 ABA
 STAA CSRPAND1
 RTS
;
; HORIZ TAB LEFT
TABLFT BSR GETTAB GET TAB POS
 LDAB CSRPAND1
 ANDB =$1F
 CBA
 BNE 5+*
 SUBA TAB ON TAB; MOVE LEFT
 BGE 1+*
 CLRA
 BRA TB10
;
; LAST TAB POSITION =
; (CURSOR / TAB) * TAB
GETTAB CLR ARA
 LDAA TAB
 STAA AR0
 LDAA CSRPAND1
 ANDA =$1F
 CLRB
 JSR DIVIDE
 LDAB TAB
 STAB AR0
 JMP MULT
;
SETTAB LDAA NUMAND1
 CMPA =2
 BGE 2+*
 LDAA =8
 STAA TAB
 RTS
;
; TURN ON CHAR INSERT
CHRINS LDAA =1
 STAA INSFLG
 RTS
;
; TURN OFF CHAR INSERT
INSOFF CLR INSFLG
 RTS
;
;
;
;
;
;
;
SRCHBF      .EQU    $110 STR ARG BUFFER
UPHOME      .EQU    $FC37
LFTJST      .EQU    $FCFD
DELTOP      .EQU    $FCA9
CLEAR2      .EQU    $FC43
INSTOP      .EQU    $FC95
RTARRO      .EQU    $FCA5
LFARRO      .EQU    $FCB3
SUB32X      .EQU    $FCCB
ADD32X      .EQU    $FCD5
GETCHR      .EQU    $FC4A
CLEAR       .EQU    $FC3D
EDTCHR      .EQU    $FC8F
LOADX       .EQU    $FE29
ADCBIN      .EQU    $FF2A
PUTCHR      .EQU    $FCBC
CRLFXX      .EQU    $FD14
KBDPIA      .EQU    $FC64
MULT        .EQU    $FF93
DIVIDE      .EQU    $FFAF
SCRP2       .EQU    $FD67
OVR3        .EQU    $FCED
MOVE2       .EQU    $FD46
MOVE1A      .EQU    $FD35
; END ; NO END REQUIRED FOR SBASM3 ASSEMBLY
 
