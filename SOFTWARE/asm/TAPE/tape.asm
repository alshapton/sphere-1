;
;      DIRECTIVES FOR ASSEMBLY FOR SBASM3
;
        .CR 6800               ; LOAD MC6800 CROSS OVERLAY
        .TF TARGET.BIN,BIN   ; OUTPUT FILE TO TARGET.BIN IN BINARY FORMAT
        .OR $FB00              ; START OF ASSEMBLY ADDRESS

;      SBASM3 ALSO NEEDED EQU CHANGING TO .EQU


;      NAM     PDS-SYS2N
;      OPT     0,NOG
;
;      PDS SYSTEM 2NF CASSETTE DRIVERS (SYS2N)
;
;      PROGRAMMED BY ERIC JAMESON
;
;
;
;      COPYRIGHT 1976 SPHERE CORPORATION
;      940 N.  400 EA.;  NORTH SALT LAKE, UTAH 84054
;
;      P.O. BOX 213;  BOUNTIFUL, UTAH  84010
;
;
;
;
;      SPHERE RESERVES ALL RIGHTS FOR THE REPRODUCTION,
;      DISTRIBUTION AND USE OF THE PDS SOFTWARE.
;      NO COPIES MAY BE MADE OR DISTRIBUTED WITHOUT THE
;      WRITTEN PERMISSION OF SPHERE CORP.
;
;
;
;
;
; THE PROGRAM DEVELOPMENT SYSTEM (PDS SYS2N) IS A SET OF
; PROGRAMS RESIDING ON ERASABLE PROGRAMMABLE READ ONLY
; MEMORY WHICH ALLOW EVEN THE SMALLEST USER TO USE HIS
; SPHERE SYSTEM AS A COMPLETE COMPUTER SYSTEM FOR THE
; DEVELOPMENT OF COMPUTER PROGRAMS.
;     TOWARD THIS END, THE 5 PDS EPROMS CONTAIN A CURSOR
; BASED EDITOR, A MINI-ASSEMBLER, AND THE SPHERE DEBUGGING
; AID (SDA), AS WELL AS A SET OF UTILITY ROUTINES TO DO 16
; BIT MULTIPLY AND DIVIDE, ASCII-TO-BINARY, AND
; BINARY-TO-ASCII ROUTINES, AND ROUTINES TO DO
; INPUT AND OUTPUT TO THE AUDIO CASSETTE.
;
;
;
;     THE SYS2N SOFTWARE IS AN UPGRADE OF THE PDS V3A
; (V3N & V3D) SOFTWARE DESIGNED TO RUN WITH THE CASSETTE
; SYSTEM.  THERE ARE TWO VERSIONS OF THE SYS2 SOFTWARE:
; SYS2N WHICH RUNS WITH THE NEW KEYBOARD AND THE SYS2A
; WHICH RUNS WITH THE ORIGIONAL (KBD/1A) KEYBOARD.  THE
; MAIN DIFFERENCE BETWEEN THE V3A AND SYS2 VERSIONS ARE
; THAT A FIFTH EPROM HAS BEEN ADDED AND THAT THE MINI-
; ASSEMBLER HAS BEEN DELEATED AND REPLACED WITH A SET OF
; COMMANDS TO DO LOADING AND DUMPING OF CASSETTE TAPES.

;                MEMORY MAP
;
TMP     .EQU    $00
TMP1    .EQU    $02
ARB     .EQU    $04         ; 16 BIT ACC. PSEUDO REG B.
AR3     .EQU    $04         ; _HI BYTE OF ARB.
AR2     .EQU    $05         ; _LO BYTE OF ARB.
ARA     .EQU    $06         ; 16 BIT ARITH PSEUDO REG A.
AR1     .EQU    $06         ; _HI BYTE OF ARA.
AR0     .EQU    $07         ; _LO BYTE OF ARA.
DIGIT   .EQU    $08         ; BYTE USED BY ASCBIN FOR TEMP.
CSTATS  .EQU    $09         ; CASSETTE I-O STATUS BYTE.
OUTEND  .EQU    $0A         ; END OF OUTPUT BUFFER TEXT.
BUFADR  .EQU    $0C         ; START OF I/O BUFFER (PTR)
BUFEND  .EQU    $0E         ; PTR. TO END OF I/O BUFFER.
OUTBUF  .EQU    $11         ; START OF OUTPUT BUFFER.
CASNUM  .EQU    $13         ; PHYSICAL CASSETT NUMBR.
SRCADR  .EQU    $14         ; SOURCE FOR TEXT MOVES.
DSTADR  .EQU    $16         ; DEST. ADDR. FOR TEXT MOVE.
ENDMEM  .EQU    $1A         ; LAST ADDRES OF REAL MEMORY.
CSRPTR  .EQU    $1C         ; PTR TO CURSER ON SCREEN.
BUFPTR  .EQU    $1E         ; TEMP PTR USED BY OUTSTR.
BUFFLO  .EQU    $20         ; PTR TO END OF LOW EDIT TXT.
BUFFHI  .EQU    $22         ; PTR TO START OF HI TEXT.
SCNPTR  .EQU    $24         ; PTR. TO BUFFRD TXT START. 
SRCASM  .EQU    $26         ; PTR TO ASSMBLR SOURCE CODE.
ONDVAL  .EQU    $2A         ; HAS ASSMBLR OPERND VALUE.
SYMVAL  .EQU    $2C         ; VALUE OUT IN ASSM. SYMTBL.
BRKSAV  .EQU    $2E         ; TEMP SAVE FOR BRKPT DATA.
BRKADR  .EQU    $30         ; ADDDRESS OF BREAKPOINT.
EDIT    .EQU    $32         ; 0 IF EDITOR IS NOT RUNNING.
BLKNAM  .EQU    $33         ; CASSETTE BLOCK NAME.
IOBUFF  .EQU    $35         ; I-O BUFFER FOR DEBUGGER.
ACIANO  .EQU    $38         ; SYS2N CASSETTE ACIA ADDR.
NOPRNT  .EQU    $3A         ; CASSETTE NAME PRINT FLAG.
BLKTYP  .EQU    $3B         ; CASSETTE BLOCK TYPE CODE.
BFRPTR  .EQU    $3C         ; ADDR. OF I-O BUFF. FOR CASS.
BFRSZE  .EQU    $3E         ; LENGTH OF CASS. BUFFER.
PCVAL   .EQU    $40         ; PROGRAM COUNTER FOR ASSM.

;       FOLLOWING ARE VARIABLE VALUES
;
TIMEA   .EQU    $26F0       ; TIMER COUNTER.
ON      .EQU    $B1         ; ACIA VALUE TO TURN ON CASS.
OFF     .EQU    $51         ; ACIA VALUE TO STOP CASS.
ETX     .EQU    $03         ; END-OF-TEXT.
SYN     .EQU    $16         ; SYNCHRONISE.
ETB     .EQU    $17         ; END-OF-TRANSMISSION-BLOCK.
ESC     .EQU    $1B         ; EXCAPE TO NONSTANDARD HDR.
ERR4    .EQU    'T'         ; SET FOR TRAILER ERROR.
ERR5    .EQU    'C'         ; SET FOR CHECKSUM ERR.
TIME    .EQU    20833       ; TIME CNTR FOR 1/4 SEC.
TIMCNT  .EQU    9           ; TIMES FOR 2 & 1/4 SECONDS.

;
;        ORG     $FB00 ; REPLACED WITH .OR DIRECTIVE FOR SBASM3
;
;
;          CASSETTE I-O DRIVERS
;
;     THE CASSETTE DRIVERS LOAD AND DUMP A BLOCK OF DATA
; TO AND FROM THE CASSETTE.  THEY HANDLE BOTH THE HEADER
; AND TRAILER FORMATTING.
;     THE DRIVERS ARE SET UP AR A SET OF SUBROUTINES
; CALLED BY THE EXECUTIVE OR THE USER'S PROGRAMS.
;
;
;
;      LOW MEMORY ADDRESSES USED  Y THE DRIVERS ARE:
;
;      CSTATS  AT  09    USED TO STORE INPUT ERR CODE.
;      BLKNAM  AT  33    2 CHARS. NAME OF BLOCK.
;      ACIANO  AT  38    PTR. TO THE ACIA CURRENTLY USED.
;      NOPRNT  AT  3A    PRINT FLAG FOR BLOCK NAME.
;      BFRPTR  AT  3C    START OF CASSETTE I-O BUFFER.
;      BFRSZE  AT  3E    END OF CASSETTE DATA BUFFER.
;
;
;     THE DRIVERS CAN BE RUN FROM THE PDS-SYS2N SOFTWARE
; SYSTEM, WHICH CONTAIN THE CASSETTE LOAD AND DUMP
; COMMANDS IN THE EXEC, OR FROM THE PDS-V3A, WHERE THE
; DRIVERS ARE CALLED THROUGH THE DEBUGGER.
;
;     THE DRIVERS DISPLAY PERTINENT DATA ON THE SCREEN
; WHEN WRITING OR READING FROM THE CASSETTES.  ON A WRITE,
; THE CHARACTERS BEING WRITTEN ONTO THE CASSETTE ARE
; DISPLAYED IN THE SECOND CHARACTER POSITION FROM THE
; UPPER RIGHT HAND CORNER OF THE SCREEN.  ON A READ, THE
; CHARACTERS BEING READ IN ARE DISPLAYED IN THE UPPER
; RIGHT HAND CORNER OF THE SCREEN.  THE NAME OF THE BLOCK
; CURRENTLY BEING READ OR SEARCHED OVER IS DISPLAYED ON THE
; RIGHT HAND SIDE OF THE SECOND LINE.  THE ERROR CODE FOR
; A READ IS DISPLAYED ON THE RIGHT SIDE OF THE THIRD LINE.
; NO CHANGE IN CHARACTER MEANS THAT THE READ WAS O.K.
; A "C" MEANS THERE WAS A CHECKSUM ERROR ON THE BLOCK.
; A "T" MEANS THAT THE WRONG NUMBER OF BYTES WERE READ
;  INTO THE BUFFER (TRAILER ERROR).  THIS WOULD OF COURSE
;  IMPLY A CHECKSUM ERROR ALONG WITH THE TRAILER ERROR.
;
;     THE CSTATS (CASSETTE STATUS) BYTE WILL CONTAIN A 0
; IF THE BLOCK READ IN WAS O.K.  IF IT WAS A BAD READ, IT
; WILL CONTAIN A 54 FOR TRAILER ERRROR OR A 43 FOR A
; CHECKSUM ERROR CODE UPON EXIT FROM THE ROUTINE.
;
;     SETTING THE NOPRNT (NO PRINTING) FLAG TO A 0 WILL
; STOP THE DISPLAY OD CHARACTERS ON THE SCREEN DURING
; CASSETTE READ AND WRITE, EXCEPT FOR THE T & C ERROR
; CODES, WHICH ARE ALWAYS DISPLAYED WHEN THEY OCCUR.
;
;     IF THE FIRST BYTE OF BLKNAM (BLOCK NAME) IS A 0
; WHEN THE READ BLOCK ROUTINE IS ENTERED, THE NEXT BLOCK
; WILL BE READ FROM TAPE NO MATTER WHAT THE NAME OF THE
; TAPE BLOCK IS.  ON THE SYS2N EXEC, A CONTROL SPACE
; CHARACTER CAN BE TYPED IN AS THE FIRST CHARACTER OF THE
; NAME IN THE LOAD BLOCK COMMAND.  THUS, A (CNTL L)(CNTL
; SPACE)(X) WOULD READ IN THE NEXT BLOCK ON THE TAPE.
;
;
;
;     THE TAPE FORMAT IS:
;       SYN
;       SYN
;       SYN
;       ESC
;       HI BYTE IF 16 BIT BLOCK LENGTH
;       LOW BYTE OF BLOCK LENGTH
;       FIRST CHAR OF BLOCK NAME
;       SECOND CHARACTER OF NAME
;       DATA
;       .
;       .
;       .
;       DATA
;       ETB
;       CHECKSUM
;       CHECKSUM
;       CHECKSUM
;       CHECKSUM
;
;
;
;     THE CHECKSUM IS CALCULATED FROM THE DATA, WHICH
; IS READ IN FROM THE CASSETTE BUFFER RESIDING IN MEMORY.
;
;
;     THE FORMAT FOR THE CASSETTE BUFFER IS:
;
;        BFRPTR                     BFRSZE
;        |                               |
;        V                               V
;        C A S S E T T E       B U F F E R
;
;
;     WHEN DATA IS READ IN, THE READ ROUTINE SETS 'BFRSZE'
; TO POINT TO THE LAST CHARACTER READ INTO THE BUFFER.
; NOTE THAT THERE IS NO OVERFLOW CHECK WHEN DATA IS READ
; INTO MEMORY.  ON OUTPUT TO THE CASSETTE, THE BLOCK
; LENGTH IS CALCULATED FROM THE BFRPTR AND BFRSZE POINTERS.
;
;
;     THE READ BLOCK AND WRITE BLOCK ROUTINES AUTOMATICALLY
; TURN ON AND OFF THE CASSETTE.
;
;
;     THE ADDRESSES OF THE ROUTINES FOR CONTROLLING
;     THE CASSETTE ARE AS FOLLOWS:
;
;     INTLZ  - FB00 : INITIALIZES THE ACIA FOR USE.
;     WRTBLK - FB2D : WRITES A FORMATTED BLOCK TO CASSETTE
;     RDBLK  - FB91 : READS IN A FORMATTED BLOCK OF TAPE
;     WRTMOD - FB2F : WRITES A BLOCK TO A RUNNING CASSETTE
;     RDMOD  - FB93 : READS A BLOCK FROM A RUNNING TAPE.
;     CASOUT - FB62 : WRITES OUT ONTO TAPE THE BYTE IN A.
;     CASIN  - FB7E : READS IN A BYTE INTO ACCUM. A
;     TURNON - FB77 : TURNS ON THE CASSETTE DRIVE.
;     TRNOFF - FBB0 : TURNS OFF THE CASSETTE DRIVE WHEN THE
;                     POINTR TO ACIA IS PASSED IN THE X REG.
;
;    NOTE THAT ALL THE ABOVE ROUTINES ARE SUBROUTINES THAT
;     ARE ENTERED BY A JSR OR BSR CALL.
;
;
;
;
; USING THE CASSETTE DRIVERS.
;
;     IF THE EPROMS ON THE CPU BOARD ARE THE SYS2N OR THE
; SYS2D PROMS, THE DRIVERS ARE USED BY THE I (INITIALIZE),
; L (LOAD FROM CASSETTE) AND S (STORE ONTO CASSETTE)
; COMMANDS THAT ARE A PART OF THE SYS-2 EXECUTIVE.
;
;     IF THE CPU PROMS BEING USED ARE THE PDS-V3A OR THE
; PDS-V3N OR V3D PROM SETS, THEN THE USER MUST SET UP THE
; POINTERS AND CALL THE ROUTINES HIMSELF, USING THE
; DEBUGGER ON THE CPU PROMS.  (NOTE THAT THE V3A AND V3N
; DEBUGGERS VARY, FOR INSTANCE THE V3A GO COMMAND IS A 'G'
; WHILE THE V3N GO COMMAND IS A 'CNTL G'.  REFER TO THE
; USERS MANUAL FOR DETAILES.)
;     THE FIRST THING TO DO IS OPEN THE LOW MEMORY LOCATIONS
; USED BY THE DRIVERS AS FLAGS AND POINTERS AND INITIALIZE
; THE LOCATIONS.  THE ACIANO, BLKNAM, BFRPTR AND BFRSZE
; SHOULD NOW BE GIVEN VALUES.
;     ACIANO WOULD POINT TO F050 FIR THE FIRST CASSETTE AND
; TO F060 FOR THE SECOND CASSETTE DRIVE.
;     A SIMPLE PROGRAM TO CALL THE ROUTINES SHOULD NOW BE
; WRITTEN.  OPEN LOCATION 900.  TYPE IN THROUGH THE DEBUGGER
; THE INSTRUCTIONS JSR BDXX, JMP FE4F.  XX IS THE SECOND BYTE
; OF THE DESIRED DRIVER ROUTINE, I.E. 00 FOR INITIALLIZATION
; OR 91 FOR READING A BLOCK OR 2D FOR WRITING A BLOCK.  THUS
; TO INITIALIZE AN ACIA, ACIANO WOULD BE LOADED WITH
; THE ADDRESS OF THE ACIA AND THE USER WOULD THEN JUMP TO THE
; ROUTINE AT 900 BY OPENING 900 AND JUMPING TO IT WITH
; THE 'G' COMMAND.  THE ROUTINE WOULD BE AS FOLLOWS:
;
;CALL 900  BD     JSR
;     901  FB     HI BYTE OF ROUTINE AADDRESS
;     902  00     LOW BYTE OF DRIVER ADDRESS.
;     903  7E     JMP
;     904  FE     ADDRESS OF THE DEBUGGER ON
;     905  4F     THE PDS V3A PROM SET
;
;     THE ACIA WOULD NOW BE INITIALIZED AND CONTROL WOULD
; HAVE RETURNED TO THE DEBUGGER.  TO READ IN A BLOCK,
; THE NAME WOULD BE PUT IN BLKNAM AND LOCATION 902 WOULD
; BE CHANGED TO 91.  THE USER WOULD THEN  JUMP TO 900.
;
;     TO TEST THE CASSETTE, SET BFRPTR TO E060 AND BFRSZE
; TO E0DF.  THIS WILL ALLOW THE USER TO WRITE OUT DATA
; FROM THE FOURTH, FIFTH, SIXTH AND SEVENTH LINE OF THE
; CRT DISPLAY AMD THEN READ IT BACK ONTO THE DISPLAY.  DATA
; CAN BE TYPED ONTO THE SCREEN BY OPENING A LOCATION WITH
; THE DEBUGGER AND THEN MOVING THE CURSOR AROUND THE SCREEN
; TO CHANGE THE CHARACTERS.  THIS IS POSSIBLE BECUASE THE
; ROUTINE TO INPUT AN ADDRESS CALLS THE EDITOR FOR INPUT.
;
;     THE DRIVER ROUTINES CAN ALSO BE USED TO PERFORM
; I-O WITH A MODEM OR TELETYPE.  THE MAIN HARDWARE
; DIFFERENCE BETWEEN THE CASSETTE AND MODEM/TTY IS THAT THE
; CASSETTE HAS A DIVIDE BY 16 CLOCK AND IS UNIDIRECTIONAL
; WHILE THE MODEM/TTY HAVE A DIVIDE BY 64 CLOCK AND CAN BE
; BIDIRECTIONAL.  BECAUSE OF THE CLOCK CHANGE THE ACIA MUST
; BE TURNED ON WITH A DIFFERENT VALUE BEFORE THE READ BLOCK
; OR WRITE BLOCK ROUTINES ARE ENTERED.  TO TURN ON THE ACIA
; STORE THE VALUE 'B2' INTO LOCATION F050 OR F060.  ONCE
; IT IS TURNED ON, EITHER CASIN OR CASOUT MAY BE CALLED
; REPEATEDLY OR WRITE MODEM BLOCK (WRTMOD) OR READ MODEM
; (RDMOD) CAN BE CALLED ONCE.  WRTMOD & RDMOD ARE THE SAME
; AS WRTBLK & RDBLK EXCEPT THEY DO NOT TURN ON THE ACIA.  A
; PROGRAM TO READ IN A BLOCK OF DATA FROM A MODEM OR TTY
; WOULD THUS BE (PLACED BEFORE THE 'CALL' ROUTINE):
;     8FA  DE 38  LDX    ACIANO   LOADS ACIA POINTTER.
;     8FC  86 B2  LDA A  #$B2     LOADS STARTUP VALUE.
;     8FE  A7 00  STA A  0,X      PUTS START CODE INTO ACIA.
; LOCATION 902 WOULD NOW BE 2F FOR WRITING AND 93 TO READ.
;     TO READ IN A CHARACTER FRO, THE TELETYPE TURN ON THE
; ACIA AND GO TO THE FOLLOWING ROUTINE:
;     TTYIN  JSR    CASIN   READS IN A CHAR FROM KEYBOARD.
;            JMP    CASOUT  TYPES OUT CHAR ON PRINTER.
; THE RS232 SHOULD HAVE BEEN STRAPPED TO HALF DUPLEX.
;
;
;     IT IS TO BE STRESSED THAT  THE RELIABILITY OF THE
; CASSETTE CONTROLLER DEPENDS ON THE ADJUSTMENT OF THE
; TRIMMER ON THE SIM BOARD.  IF THE TRIMMER IS OUT OF
; ADJUSTMENT THE DATA WILL NOT READ IN PROPERLY.  BESIDES
; USING THE OSCILLOSCOPE TO ADJUST THE TRIMMER, IT CAN ALSO
; BE ADJUSTED BY READING IN A STRING OF SINGLE CHARACTERS
; FROM  THE CASSETTE AND ADJUSTING IT UNTIL THE CHARACTERS
; SYNC IN PROPERLY.  THE BEST CHARACTER TO USE IS A STRING
; OF 'U'S.  TO READ IN THE STRING FOR TESTING USE, WRITE A
; LOOP TO GET A CHARACTER FROM THE CASSETTE AND THEN
; DISPLAY THAT CHARACTER.  A SAMPLE TOUTINE TO DO THIS IS:
;    A  JSR  $FB7E   LOADS A WITH CASSETTE CHAR.
;       JSR  $FCAD   PDS-V3A PUTCHR ROUTINE.
;       TST  $F001   TESTS KEYBOARD FOR A KEY.
;       BPL  A       SKIPS BACK IF NO INPUT.
; THE ABOVE ROUTINE WOULD INPUT CHARACCTERS UNTIL A KEY
; ON THE KEYBOARD WAS DEPRESSED.

;       INTLZ INITIALIZES THE ACIA CONTROLLER FOR
;       A SPECIFIC TAPE UNIT AT MOUNT TIME.
;
INTLZ   LDX     ACIANO      ; X GETS ACIA ADDRESS.
        LDAA    #$13        ; RESETS THE ACIA.
        STAA    0,X         ; .
        LDAA    #OFF        ; SETS ACIA TO
        STAA    0,X         ; /16 2 STOPS. BIT FORMAT.
        RTS
        
;       WRTHDR FORMATS THE HEADER ON THE TAPE.
;
WRTHDR  LDAA    #SYN        ; PUTS SYNC CHARS ONTO TAPE.
        BSR     CASOUT      ; .
        BSR     CASOUT      ; .
        BSR     CASOUT      ; .
        LDAA    #ESC        ; .
        BSR     CASOUT      ; .
        LDAA    BFRSZE      ; FOLLOWING OUTPUTS LENGTH.
        LDAB    BFRSZE+1    ; LOADS LO BYTE OF END PTR.
        SUBB    BFRPTR+1    ; SUBS LO BYTE OF BEGIN PTR.
        SBCA    BFRPTR      ; SUBS HI BYTE OF START PTR.
        BSR     CASOUT      ; OUTPUTS HI LENGTH BYTE.
        TBA                 ; LOADS LO BYTE OF LENGTH.
        BSR     CASOUT      ; OUTPUTS LOW LENGTH BYTE.
        LDAA    BLKNAM      ; OUTS OUT NAME OF BLOCK.
        BSR     CASOUT      ; .
        LDAA    BLKNAM+1    ; .
        BSR     CASOUT      ; PUTS OUT LAST OF NAME.
        RTS                 ; RETURNS BACK TO WRTBLK.
        
;       WRTBLK WRITES OUT A BLOCK OF DATA TO THE CASSETTE.
;
WRTBLK  BSR     TURNON      ; TURNS ON THE CASSETTE.
;        FOLLOWING WAITES FOR CASSETTE TO GET UP TO SPEED.
WRTMOD  LDAB    #TIMCNT     ; LOADS TIME LOOP COUNTER.
TIME1   LDX     #TIME       ; MASTER TIME LOOP (1/4 SEC).
TIME2   DEX                 ; COUNTS CYCLES OF LOOP.
        BNE     TIME2       ; TESTS FOR FIRST TIME OUT.
        DECB               ; COUNTS TIMES IN LOOP.
        BNE     TIME1       ; SKIPS BACK UNTIL DONE.
;        THE TIME LOOP IS NOW FINISHED.
        BSR     WRTHDR      ; WRITES HEADER ON THE TAPE.
        BSR     WRTBFR      ; WRITES OUT BUFFER DATA.
;        FOLLOWING WRITES THE TRAILER OUT ONTO THE TAPE.
WRTTLR  LDAA    #ETB        ; OUTPUTS END-OF-BLOCK CHAR.
        BSR     CASOUT      ; ETB IS DISPLAYED AS A "W".
        TBA                 ; A GETS CHECKSUM FROM B.
        BSR     CASOUT      ; OUTPUTS THE CHECKSUM.
        BSR     CASOUT      ; OUTPUTS THE TRAILER FILLER
        BSR     CASOUT      ; BYTES.
        BSR     CASOUT      ; .
;        END OF TRAILER WRITING ROUTINE.
        BSR     TRNOFF      ; HALTS CASSETTE DRIVE.
        RTS                 ; -


;       WRTBFR WRITES OUT THE CONTENTS OF THE
;       BUFFER ONTO THE CASSETTE TAPE.
;
;
WRTBFR  CLRB                ; INIT CECKSUM COUNT.
        LDX     BFRPTR      ; ACIA CONTROL MASK. DER: ?????
WBFR1   LDAA    0,X         ; LOADS CHAR. FROM BUFFER.
        STX     TMP         ; SAVES BUFFER PTR.
        BSR     CASOUT      ; PUTS CHAR ONTO CASSETTE.
        ABA                 ; A GETS A+B.
        TAB                 ; B GETS A+B.
        LDX     TMP         ; RESTORES PTR. INTO BUFFR.
        CPX     BFRSZE      ; TESTS IF BUFFER EMPTY.
        BEQ     CSOEXT      ; EXITS WHEN EMPTY.
        INX                 ; INC POINTER.
        BNE     WBFR1       ; SKIPS BACK IF CHARS. LEFT.

;       CASOUT TAKES THE CHAR IN A AND PUTS IT OUT
;       ONTO THE CASSETTE TAPE.
;
;
CASOUT  PSHA                ; SAVES CHAR TO READ OUT.
        LDX     ACIANO      ; X GETS PHYSICAL ACIA ADDR.
        LDAA    #2          ; LOADS CONTROL TEST BITS.
CAS01   BITA    0,X         ; TESTS IF ACIA BUFFER EMPTY.
        BEQ     CAS01       ; LOOPS BACK UNTIL READY.
        PULA                ; GETS ORIG CHAR.
        STAA    1,X         ; STORS CHAR INTO ACIA BUFFER.
        TST     NOPRNT      ; TESTS IF PRINTOUT ALLOWED.
        BEQ     CSOEXT      ; SKIPS PRINTING IF A 0.
        STAA    $E01E       ; DISPLAYS CHAR ON SCREEN.
CSOEXT  RTS

;        TURNON TURNS ON THE CASSETTE DRIVE.
;
;
TURNON  LDX     ACIANO      ; LOADS CASSETTE ACIA ADDRESS.
        LDAA    #ON         ; .
        STAA    0,X         ; TURNS ACIA ON.
        RTS


;       CASIN READS IN A CHARACTER FROM THE CASSETTE TAPE
;       INTO THE A ACCUMULATOR.
;
;
CASIN   LDX     ACIANO      ; X GETS THE ACIA ADDRESS.
        LDAA    #1          ; LOADS TEST BITS.
CASIN1  BITA    0,X         ; TESTS IF ACCIA BUFFR FULL.
        BEQ     CASIN1      ; SKIPS BACK IF NOT IN YET.
        LDAA    1,X         ; LOADS IN CHAR FROM TAPE.
        TST     NOPRNT      ; TESTS IF PRINT IS OFF.
        BEQ     CINEXT      ; SKIPS DISPLAYING IF 0.
        STAA    $E01F       ; DISPLAYS CHR ON TV.
CINEXT  RTS                 ; .

;       RDBLK READS IN A BLOCK FROM THE CASSETTE
;       TAPE INTO BUFFER MEMORY.
;
;
RDBLK   BSR     TURNON      ; TURNS ON TAPE DRIVE.
RDMOD   BSR     RDHDR       ; READS IN THE HEADER.
        BSR     RDBFR       ; READS IN DATA INTO BUFFER.
;        FOLLOWING READS IN TRAILER AND CHECKS CHECKSUM.
RDTLR   CLRA                ; LOADS A 0 FOR A GOOD READ.
        STAA    CSTATS      ; SETS STATUS BYTE TO NO ERR.
        BSR     CASIN       ; INPUTS END-OF-BLOCK CHAR.
        CMPA    #ETB        ; ETB DISPLAYS AS A "W".
        BEQ     RTLR1       ; SKIPS IF N0 ETB ERROR.
        LDAA    #ERR4       ; LOADS TRAILER ERROR CODE.
        BRA     RTLR2       ; SKIPS TO STORE ERROR CODE.
RTLR1   BSR     CASIN       ; READS IN CHECKSUM.
        CBA                 ; TESTS CHECKSUM.
        BEQ     TRNOFF      ; SKIPS IF OK.
        LDAA    #ERR5       ; SETS CHECKSUM ERROR CODE.
RTLR2   STAA    CSTATS      ; SETS ERROR STATUS BYTE.
        STAA    $E05F       ; DISP. ERR CODE ON SCREEN.
;        END OF TRAILER READ IN.
;        FOLLOWING TURNS OFF THE CASSETTE DRIVE.
TRNOFF  LDAA    #OFF        ; LOADS COMMAND TO TURN
        STAA    0,X         ; OFF ACIA CASSETTE DRIVE.
        RTS                 ; .


;       RDHDR FINDS THE START OF THE BLOCK ON THE TAPE,
;       FIGURES THE BUFFER END AND CHECKS THE NAME.
;
;
RDHDR   BSR     CASIN       ; FOLLOWING FINDS THE
RDHDR1  CMPA    #SYN        ; START OF THE HEADER.
        BNE     RDHDR       ; .
        BSR     CASIN       ; TESTS FOR HEADR CHAR.
        CMPA    #ESC        ; START-OF-HEADER.
        BNE     RDHDR1      ; GOES BACK IF NOT GOOD HDR.
        BSR     CASIN       ; READS IN HI BYTE OF LEN.
        TAB                 ; SAVES HI LENGTH BYTE.
        BSR     CASIN       ; INPUTS LO SIZE (LEN) BYTE.
        ADDA    BFRPTR+1    ; FORMS POINTER TO THE
        ADCB    BFRPTR      ; TOP BYTE OF THE BUFFER.
        STAA    BFRSZE+1    ; SAVES THE HI BUFF. PTR.
        STAB    BFRSZE      ; TO THE CASSETTE BUFFER.
        BSR     CASIN       ; READS IN BLOCK NAME.
        PSHA                ; SAVES FIRST CHAR OF NAME.
        BSR     CASIN       ; READS IN SECOND CHAR INTO A.
        LDAB    NOPRNT      ; TESTS IF PRINT IS OFF.
        PULB                ; RESTORES FIRST NAME CHAR.
        BEQ     RHDR1       ; SKIPS IF PRINT FLAG IS 0.
        STAB    $E03E       ; DISPLAYS BLOCK NAME ON
        STAA    $E03F       ; THE CRT SCREEN.
RHDR1   TST     BLKNAM      ; TESTS IF NAME IS CHECKED.
        BEQ     RHDR2       ; SKIPS IF NO NAME CHECK.
        CMPB    BLKNAM      ; TESTS FIRST CHAR OF NAME.
        BNE     RDHDR       ; SKIPS BACK IF BAD NAME
        CMPA    BLKNAM+1    ; TESTS SECOND NAME CHAR.
        BNE     RDHDR       ; SKIPS BACK IF BAD NAME.
RHDR2   RTS                 ; .

;       RDBFR READS DATA INTO THE MEMORY BUFFER FROM
;       THE CASSETTE.
;
;
RDBFR   CLRB                ; INIT B FOR CHECKSUM.
        LDX     BFRPTR      ; LOADS START OF BUFFER.
RBFR1   STX     TMP         ; .
        BSR     CASIN       ; A GETS CHAR READ IN.
        LDX     TMP         ; X GETS BUFFER PTR.
        STAA    0,X         ; STORS CHAR INTO BUFFER.
        ABA                 ; A GETS A+B.
        TAB                 ; B GETS A.
        CPX     BFRSZE      ; TESTS IF BUFFER FULL.
        BEQ     RHDR2       ; SKIPS TO EXIT IF ALL IS IN.
        INX                 ; INC TO NEXT CHAR POSITIN.
        BNE     RBFR1       ; GOES BACK IF ANY LEFT.
        
;        END                ; NO END REQUIRED FOR SBASM3 ASSEMBLY
        
